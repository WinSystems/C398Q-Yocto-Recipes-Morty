## meta-freescale-3rdparty/conf/machine/imx6qc398.conf
```bitbake
#@TYPE: Machine
#@NAME: WinSystems i.MX6Q SBC35-C398
#@SOC: i.MX6Q
#@DESCRIPTION: Machine configuration for WinSystems i.MX6Q SBC35-C398
#@MAINTAINER: Paul DeMetrotion <pdemetrotion@winsystems.com>

require conf/machine/include/imx-base.inc
require conf/machine/include/tune-cortexa9.inc

MACHINEOVERRIDES =. "mx6:mx6dl:mx6q:"
SOC_FAMILY = "mx6:mx6dl:mx6q"

KERNEL_DEVICETREE = "imx6q-c398.dtb"

PREFERRED_PROVIDER_u-boot_mx6 = "u-boot-c398"
PREFERRED_PROVIDER_virtual/bootloader_mx6 = "u-boot-c398"
PREFERRED_PROVIDER_virtual/kernel_mx6q ??= "linux-c398"
PREFERRED_PROVIDER_kernel_imx = "linux-c398"
PREFERRED_VERSION_linux-c398 = "4.9.11"
PREFERRED_VERSION_u-boot-c398 = "2016.03"
UBOOT_CONFIG ??= "sd"
UBOOT_CONFIG[sd] = "mx6qc398_config"
UBOOT_CONFIG[sata] = "mx6qc398_sata_config"
UBOOT_CONFIG[spinor] = "mx6qc398_spinor_config"
UBOOT_CONFIG[mfgtool] = "mx6qc398_config"

SERIAL_CONSOLE = "115200 ttymxc0"

MACHINE_FEATURES += " alsa apm ext2 keyboard pci rtc screen serial usbgadget usbhost vfat"
```

## sources/meta-freescale-3rdparty/recipes-bsp/u-boot/u-boot-c398/Kconfig
```kconfig
if TARGET_MX6QC398

config SYS_BOARD
	default "mx6qc398"

config SYS_VENDOR
	default "freescale"

config SYS_CONFIG_NAME
	default "mx6qc398"

endif
```

## sources/meta-freescale-3rdparty/recipes-bsp/u-boot/u-boot-c398/mx6qc398_defconfig
```kconfig
CONFIG_ARM=y
CONFIG_ARCH_MX6=y
CONFIG_TARGET_MX6QC398=y
CONFIG_SYS_EXTRA_OPTIONS="IMX_CONFIG=board/freescale/mx6qc398/mx6q.cfg,MX6Q,DDR_MB=2048"
# CONFIG_CMD_IMLS is not set
# CONFIG_CMD_FLASH is not set
CONFIG_SPI_FLASH=y
CONFIG_SPI_FLASH_STMICRO=y
CONFIG_SPI_FLASH_ATMEL=y
```
